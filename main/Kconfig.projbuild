## main/Kconfig.projbuild
```kconfig
menu "Weather Station"

    config WIFI_SSID
        string "Wi-Fi SSID"
	default ""
        help
            SSID (network name) for the example to connect to.

    config WIFI_PASSWORD
        string "Wi-Fi Password"
	default ""
        help
            WiFi password (WPA or WPA2) for the example to use.

    config MQTT_BROKER
        string "Broker URL"
	default ""
	help
	    URL of the broker to connect to

    config PUBLISH_DHT_DATA
        bool "Publish DHT11 sensor data"
	default y

    config PUBLISH_BMP_DATA
        bool "Publish BMP180 sensor data"
	default y
    config DEEP_SLEEP_WAKE_UP_SECS
        int "Deep Sleep"
	default 1800
endmenu
```
